## config/west.yml
```yaml
manifest:
  remotes:
    - name: zmkfirmware
      url-base: https://github.com/zmkfirmware
    - name: englmaxi
      url-base: https://github.com/englmaxi
    - name: M165437
      url-base: https://github.com/M165437
  projects:
    - name: zmk
      remote: zmkfirmware
      revision: 4de313367288aad5aeaa1243890e40dc813f7008
      import: app/west.yml
    - name: zmk-dongle-display
      remote: englmaxi
      revision: 2bb333f87136d33e94a49d86236ed9ec254a8060
    - name: nice-view-gem
      remote: M165437
      revision: 0a50fe209d929c916c5664c6affd0f4977c6b012
  self:
    path: config
```
